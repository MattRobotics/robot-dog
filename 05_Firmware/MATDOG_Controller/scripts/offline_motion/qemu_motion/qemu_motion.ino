// ESP32-S3 build of the Motion scenarios, run under Espressif QEMU (run_qemu_motion.sh).
// The production Motion sources are compiled unchanged through motion_src_N.cpp
// (generated by the script: one absolute include each, of one source tree). The scenarios
// run in a 16 KB task pinned to core 1 (the Arduino loop task of MATDOG_Controller:
// SET_LOOP_TASK_STACK_SIZE(16 * 1024)); esp_timer_get_time() returns the
// simulated clock only while they run. Cost counter: CCOUNT, under -icount an
// instruction count proxy of the emulator, not ESP32-S3 cycles or time.
#include <xtensa/hal.h>
#include <esp_heap_caps.h>
#include "motion_scenarios.h"
namespace qemu_motion { int64_t gClock=0; bool gSim=false; uint32_t cycles(){return xthal_get_ccount();} void (*gProfile)(const char*,uint32_t)=nullptr; }

extern "C" int64_t __real_esp_timer_get_time();
extern "C" int64_t IRAM_ATTR __wrap_esp_timer_get_time(){return qemu_motion::gSim?qemu_motion::gClock:__real_esp_timer_get_time();}
static qemu_motion::Sim sim;  // the Controller object is static in the firmware too
#ifdef MOTION_PROFILE
void qemuProfileInstall();  // qemu_profile.cpp
#endif
#ifdef MATDOG_DIAG_PREEMPTION
// Diagnostic-build check (run_qemu_motion.sh --diag): a priority-5 task on the
// Motion core busy-waits 3 ms every 7 ms; each 15 ms "release" (real esp_timer,
// busy) must report about that share as other tasks' time (MotionTiming.h).
#include "MotionTiming.h"
static void preemptor(void*){for(;;){const int64_t t=esp_timer_get_time();while(esp_timer_get_time()-t<3000){}vTaskDelay(pdMS_TO_TICKS(7));}}
static void diagPreemption(){
  matdog::simple::timing::arm();uint32_t maximum=0;uint64_t sumOther=0,sumWall=0;TaskHandle_t h=nullptr;
  for(int phase=0;phase<2;++phase){if(phase)xTaskCreatePinnedToCore(preemptor,"pre",2048,nullptr,5,&h,1);uint64_t other=0,wall=0;
    for(int k=0;k<40;++k){const int64_t t0=esp_timer_get_time();
      {matdog::simple::timing::Release r(maximum,uint64_t(t0),"DIAG",k,0,0,0);while(esp_timer_get_time()-t0<15000){}}
      other+=matdog::simple::timing::state.working.otherTasksUs;wall+=esp_timer_get_time()-t0;vTaskDelay(1);}
    printf("DIAG_PREEMPTION preemptor=%d releases=40 wall_us=%llu other_tasks_us=%llu share=%.3f\n",phase,(unsigned long long)wall,(unsigned long long)other,double(other)/double(wall));}
  if(h)vTaskDelete(h);}
#endif
static void runner(void*){
#ifdef MATDOG_DIAG_PREEMPTION
  diagPreemption();printf("DONE\n");fflush(stdout);vTaskDelete(nullptr);  // diagnostic check only
#endif
#ifdef MOTION_PROFILE
  qemuProfileInstall();
#endif
  const size_t heap0=heap_caps_get_free_size(MALLOC_CAP_8BIT);
  printf("PLATFORM esp32s3-qemu cpu_mhz=%lu core=%d task_stack=16384 sim_bytes=%u\n",(unsigned long)getCpuFrequencyMhz(),xPortGetCoreID(),unsigned(sizeof(sim)));
  qemu_motion::gSim=true;qemu_motion::run(sim);qemu_motion::gSim=false;
  printf("STACK motion_task_min_free_bytes=%u heap_free_delta=%d\n",unsigned(uxTaskGetStackHighWaterMark(nullptr)),int(heap_caps_get_free_size(MALLOC_CAP_8BIT))-int(heap0));
  printf("DONE\n");fflush(stdout);vTaskDelete(nullptr);}
void setup(){Serial.begin(115200);xTaskCreatePinnedToCore(runner,"motion",16384,nullptr,1,nullptr,1);}
void loop(){delay(1000);}
